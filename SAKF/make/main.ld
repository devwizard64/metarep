MEMORY
{
    M_CODE:     start = $008000, size = $007FB0, fill = yes, fillval = $FF;
    M_REGISTRY: start = $00FFB0, size = $000010, fill = yes, fillval = $FF;
    M_HEADER:   start = $00FFC0, size = $000040, fill = yes, fillval = $FF;
    M_CODE_01:  start = $018000, size = $008000, fill = yes, fillval = $FF;
    M_CODE_02:  start = $028000, size = $008000, fill = yes, fillval = $FF;
    M_CODE_03:  start = $038000, size = $008000, fill = yes, fillval = $FF;
    M_CODE_04:  start = $048000, size = $008000, fill = yes, fillval = $FF;
    M_CODE_05:  start = $058000, size = $008000, fill = yes, fillval = $FF;
    M_BANK_06:  start = $068000, size = $008000, fill = yes, fillval = $FF;
    M_BANK_07:  start = $078000, size = $008000, fill = yes, fillval = $FF;
    M_BANK_C4:  start = $C40000, size = $010000, fill = yes, fillval = $FF;
    M_BANK_C5:  start = $C50000, size = $010000, fill = yes, fillval = $FF;
    M_BANK_C6:  start = $C60000, size = $010000, fill = yes, fillval = $FF;
    M_BANK_C7:  start = $C70000, size = $010000, fill = yes, fillval = $FF;
    M_BANK_C8:  start = $C80000, size = $010000, fill = yes, fillval = $FF;
    M_CODE_C9:  start = $C90000, size = $010000, fill = yes, fillval = $FF;
    M_BANK_CA:  start = $CA0000, size = $010000, fill = yes, fillval = $FF;
    M_BANK_CB:  start = $CB0000, size = $010000, fill = yes, fillval = $FF;
    M_BANK_CC:  start = $CC0000, size = $010000, fill = yes, fillval = $FF;
    M_BANK_CD:  start = $CD0000, size = $010000, fill = yes, fillval = $FF;
    M_BANK_CE:  start = $CE0000, size = $010000, fill = yes, fillval = $FF;
    M_CODE_CF:  start = $CF0000, size = $010000, fill = yes, fillval = $FF;
    M_CODE_D0:  start = $D00000, size = $010000, fill = yes, fillval = $FF;
    M_BANK_D1:  start = $D10000, size = $010000, fill = yes, fillval = $FF;
    M_BANK_D2:  start = $D20000, size = $010000, fill = yes, fillval = $FF;
    M_CODE_D3:  start = $D30000, size = $010000, fill = yes, fillval = $FF;
    M_BANK_D4:  start = $D40000, size = $010000, fill = yes, fillval = $FF;
    M_CODE_D5:  start = $D50000, size = $010000, fill = yes, fillval = $FF;
    M_BANK_D6:  start = $D60000, size = $1A0000, fill = yes, fillval = $FF;
    M_BANK_F0:  start = $F00000, size = $010000, fill = yes, fillval = $FF;
    M_BANK_F1:  start = $F10000, size = $010000, fill = yes, fillval = $FF;
    M_BANK_F2:  start = $F20000, size = $010000, fill = yes, fillval = $FF;
    M_BANK_F3:  start = $F30000, size = $010000, fill = yes, fillval = $FF;
    M_BANK_F4:  start = $F40000, size = $010000, fill = yes, fillval = $FF;
    M_BANK_F5:  start = $F50000, size = $010000, fill = yes, fillval = $FF;
    M_BANK_F6:  start = $F60000, size = $010000, fill = yes, fillval = $FF;
    M_BANK_F7:  start = $F70000, size = $010000, fill = yes, fillval = $FF;
    M_BANK_F8:  start = $F80000, size = $010000, fill = yes, fillval = $FF;
    M_BANK_F9:  start = $F90000, size = $010000, fill = yes, fillval = $FF;
    M_BANK_FA:  start = $FA0000, size = $010000, fill = yes, fillval = $FF;
    M_BANK_FB:  start = $FB0000, size = $010000, fill = yes, fillval = $FF;
    M_BANK_FC:  start = $FC0000, size = $010000, fill = yes, fillval = $FF;
    M_BANK_FD:  start = $FD0000, size = $010000, fill = yes, fillval = $FF;
    M_BANK_FE:  start = $FE0000, size = $010000, fill = yes, fillval = $FF;
    M_BANK_FF:  start = $FF0000, size = $010000, fill = yes, fillval = $FF;
}
SEGMENTS
{
    CODE:       load = M_CODE,      type = ro;
    REGISTRY:   load = M_REGISTRY,  type = ro;
    HEADER:     load = M_HEADER,    type = ro;
    CODE_01:    load = M_CODE_01,   type = ro;
    CODE_02:    load = M_CODE_02,   type = ro;
    CODE_03:    load = M_CODE_03,   type = ro;
    CODE_04:    load = M_CODE_04,   type = ro;
    CODE_05:    load = M_CODE_05,   type = ro;
    BANK_06:    load = M_BANK_06,   type = ro;
    BANK_07:    load = M_BANK_07,   type = ro;
    BANK_C4:    load = M_BANK_C4,   type = ro;
    BANK_C5:    load = M_BANK_C5,   type = ro;
    BANK_C6:    load = M_BANK_C6,   type = ro;
    BANK_C7:    load = M_BANK_C7,   type = ro;
    BANK_C8:    load = M_BANK_C8,   type = ro;
    CODE_C9:    load = M_CODE_C9,   type = ro;
    BANK_CA:    load = M_BANK_CA,   type = ro;
    BANK_CB:    load = M_BANK_CB,   type = ro;
    BANK_CC:    load = M_BANK_CC,   type = ro;
    BANK_CD:    load = M_BANK_CD,   type = ro;
    BANK_CE:    load = M_BANK_CE,   type = ro;
    CODE_CF:    load = M_CODE_CF,   type = ro;
    CODE_D0:    load = M_CODE_D0,   type = ro;
    BANK_D1:    load = M_BANK_D1,   type = ro;
    BANK_D2:    load = M_BANK_D2,   type = ro;
    CODE_D3:    load = M_CODE_D3,   type = ro;
    BANK_D4:    load = M_BANK_D4,   type = ro;
    CODE_D5:    load = M_CODE_D5,   type = ro;
    BANK_D6:    load = M_BANK_D6,   type = ro;
    BANK_F0:    load = M_BANK_F0,   type = ro;
    BANK_F1:    load = M_BANK_F1,   type = ro;
    BANK_F2:    load = M_BANK_F2,   type = ro;
    BANK_F3:    load = M_BANK_F3,   type = ro;
    BANK_F4:    load = M_BANK_F4,   type = ro;
    BANK_F5:    load = M_BANK_F5,   type = ro;
    BANK_F6:    load = M_BANK_F6,   type = ro;
    BANK_F7:    load = M_BANK_F7,   type = ro;
    BANK_F8:    load = M_BANK_F8,   type = ro;
    BANK_F9:    load = M_BANK_F9,   type = ro;
    BANK_FA:    load = M_BANK_FA,   type = ro;
    BANK_FB:    load = M_BANK_FB,   type = ro;
    BANK_FC:    load = M_BANK_FC,   type = ro;
    BANK_FD:    load = M_BANK_FD,   type = ro;
    BANK_FE:    load = M_BANK_FE,   type = ro;
    BANK_FF:    load = M_BANK_FF,   type = ro;
}
